#include "web.h"
#include <ESPAsyncWebServer.h>
#include <flash_hal.h>
#include "api.h"
#include "auth.h"
#include "secrets.h"
#include "zones.h"
#include "events.h"
#include "log.h"
#include "storage.h"
#include "history.h"
#include "programs.h"
#include "web_pages.h"
#include "web_ui.h"  // generated by tools/build_web.py

namespace web {

static AsyncWebServer server(80);
static AsyncWebSocket ws("/ws");

static const size_t MAX_BODY = 6144;  // restore of config.json (incl. 8 programs)
static const uint8_t MAX_WS_CLIENTS = 4;
static const uint32_t WS_PUSH_MIN_MS = 250;      // batch status pushes
static const uint32_t WS_HEARTBEAT_MS = 15000;   // send status now and then even without changes

static bool statusDirty = false;
static uint32_t lastStatusPush = 0;
static uint32_t lastCleanup = 0;
static const uint32_t UPDATE_STALL_MS = 30000;  // upload aborted → release Update

static bool restartPending = false;
static uint32_t restartAt = 0;

// State of the running /update upload (only one can run at a time).
static bool updating = false;
static uint32_t updateLastData = 0;
static int updateCode = 200;
static String updateError;

bool updateInProgress() { return updating; }

void scheduleRestart() {
    restartPending = true;
    restartAt = millis() + 500;
}

void markStatusDirty() { statusDirty = true; }

void pushEvent(const char* type, const char* detailJson) {
    statusDirty = true;
    if (!ws.count()) return;
    String msg;
    msg.reserve(48 + strlen(type) + strlen(detailJson));
    msg += F("{\"type\":\"event\",\"event\":\"");
    msg += type;
    msg += F("\",\"data\":");
    msg += detailJson;
    msg += '}';
    ws.textAll(msg);
}

static void pushStatus() {
    JsonDocument doc;
    doc["type"] = "status";
    JsonDocument status;
    api::buildStatus(status);
    doc["data"] = status;
    String msg;
    serializeJson(doc, msg);
    ws.textAll(msg);
}

// Collect the body of API requests in req->_tempObject (freed by the library).
static void collectBody(AsyncWebServerRequest* req, uint8_t* data, size_t len, size_t index, size_t total) {
    if (total > MAX_BODY) return;
    if (index == 0) {
        req->_tempObject = malloc(total + 1);
        if (!req->_tempObject) return;
    }
    if (!req->_tempObject) return;
    memcpy(static_cast<uint8_t*>(req->_tempObject) + index, data, len);
    if (index + len == total) static_cast<char*>(req->_tempObject)[total] = '\0';
}

// /update accepts a session cookie, API key or HTTP Basic (admin:<admin password>),
// so it also works with curl when the web page won't cooperate.
static bool updateAuthorized(AsyncWebServerRequest* req) {
    return auth::check(req) != auth::Who::None || auth::basicOk(req);
}

static void failUpdate(int code, const String& error) {
    updateCode = code;
    updateError = error;
    if (updating) {
        Update.end();  // incomplete → will not be activated
        updating = false;
        events::emit("update_failed", "{\"error\":\"%s\"}", error.c_str());
    }
    LOG("Update: failed – %s", error.c_str());
}

static void onUpload(AsyncWebServerRequest* req, const String& filename, size_t index, uint8_t* data,
                     size_t len, bool final) {
    if (index == 0) {
        updateCode = 200;
        updateError = "";
        if (!updateAuthorized(req)) return failUpdate(401, "Not logged in");
        if (updating) return failUpdate(409, "An update is already running");
        if (zones::activeCount() > 0) return failUpdate(409, "A valve is open; close it first");

        const bool fs = req->hasParam("type") && req->getParam("type")->value() == "fs";
        const size_t size = fs ? FS_PHYS_SIZE : ((ESP.getFreeSketchSpace() - 0x1000) & 0xFFFFF000);
        Update.runAsync(true);  // required in async context
        if (!Update.begin(size, fs ? U_FS : U_FLASH)) return failUpdate(500, Update.getErrorString());

        updating = true;
        storage::flush();
        history::flush();
        LOG("Update: start %s (%s)", fs ? "filesystem" : "firmware", filename.c_str());
        events::emit("update_started", "{\"type\":\"%s\",\"source\":\"web\"}", fs ? "filesystem" : "firmware");
    }
    if (!updating) return;

    updateLastData = millis();
    if (Update.write(data, len) != len) return failUpdate(500, Update.getErrorString());
    if (final) {
        if (!Update.end(true)) return failUpdate(500, Update.getErrorString());
        updating = false;
        LOG("Update: done, %u bytes", (unsigned)(index + len));
        events::emit("update_finished", "{\"bytes\":%u}", (unsigned)(index + len));
    }
}

static void onUploadDone(AsyncWebServerRequest* req) {
    if (updateCode == 401 || !updateAuthorized(req)) {
        return req->send(401, "application/json", "{\"error\":\"unauthorized\",\"message\":\"Not logged in\"}");
    }
    if (updateCode != 200 || updating) {
        String body = "{\"error\":\"update_failed\",\"message\":\"" + (updateError.length() ? updateError : String("Incomplete upload")) + "\"}";
        return req->send(updateCode == 200 ? 500 : updateCode, "application/json", body);
    }
    req->send(200, "application/json", "{\"ok\":true,\"message\":\"Update succeeded, restarting\"}");
    scheduleRestart();
}

// Sends a page made up of several PROGMEM chunks (see web_pages.h).
template <size_t N>
static void sendPage(AsyncWebServerRequest* req, const char* const (&parts)[N]) {
    size_t total = 0;
    for (const char* p : parts) total += strlen_P(p);

    AsyncWebServerResponse* res = req->beginResponse(
        "text/html; charset=utf-8", total, [&parts](uint8_t* buf, size_t maxLen, size_t index) -> size_t {
            size_t written = 0;
            size_t start = 0;  // start of the current chunk within the whole page
            for (const char* p : parts) {
                const size_t len = strlen_P(p);
                if (index < start + len) {
                    const size_t off = index - start;
                    const size_t n = std::min(len - off, maxLen - written);
                    memcpy_P(buf + written, p + off, n);
                    written += n;
                    index += n;
                    if (written == maxLen) break;
                }
                start += len;
            }
            return written;
        });
    res->addHeader("Cache-Control", "no-store");
    req->send(res);
}

void begin() {
    // Same auth as the API (the session cookie is sent along with the handshake).
    ws.handleHandshake([](AsyncWebServerRequest* req) { return auth::check(req) != auth::Who::None; });
    ws.onEvent([](AsyncWebSocket*, AsyncWebSocketClient*, AwsEventType type, void*, uint8_t*, size_t) {
        if (type == WS_EVT_CONNECT) statusDirty = true;  // a new client gets the status right away
    });
    server.addHandler(&ws);

    server.on("/api", HTTP_ANY, api::handle, nullptr, collectBody);
    server.on(AsyncURIMatcher::exact("/update"), HTTP_GET, [](AsyncWebServerRequest* req) { sendPage(req, UPDATE_PAGE); });
    server.on(AsyncURIMatcher::exact("/update"), HTTP_POST, onUploadDone, onUpload);
    server.on(AsyncURIMatcher::exact("/"), HTTP_GET, [](AsyncWebServerRequest* req) {
        AsyncWebServerResponse* res = req->beginResponse(200, "text/html; charset=utf-8", WEB_UI_GZ, WEB_UI_GZ_LEN);
        res->addHeader("Content-Encoding", "gzip");
        res->addHeader("Cache-Control", "no-cache");
        req->send(res);
    });
    server.onNotFound([](AsyncWebServerRequest* req) { req->send(404, "text/plain", "Not found"); });
    server.begin();
    LOG("Web: server started on port 80");
}

void loop() {
    const uint32_t now = millis();
    if (now - lastCleanup >= 1000) {
        lastCleanup = now;
        ws.cleanupClients(MAX_WS_CLIENTS);
    }
    if (ws.count() && now - lastStatusPush >= (statusDirty ? WS_PUSH_MIN_MS : WS_HEARTBEAT_MS)) {
        statusDirty = false;
        lastStatusPush = now;
        pushStatus();
    }

    if (updating && millis() - updateLastData > UPDATE_STALL_MS) failUpdate(500, "Upload aborted");
    if (restartPending && (int32_t)(millis() - restartAt) >= 0) {
        LOG("Restarting...");
        programs::abortAll("restart");
        zones::closeAll(zones::Source::System, "restart");
        storage::flush();
        history::flush();
        ESP.restart();
    }
}

}  // namespace web
